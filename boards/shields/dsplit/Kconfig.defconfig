## boards/shields/dsplit/Kconfig.defconfig
```kconfig
if SHIELD_DSPLIT_LEFT

config ZMK_KEYBOARD_NAME
    default "DSplit"

config ZMK_SPLIT_ROLE_CENTRAL
    default y

endif # SHIELD_DSPLIT_LEFT

if SHIELD_DSPLIT_LEFT || SHIELD_DSPLIT_RIGHT

config ZMK_SPLIT
    default y

endif # SHIELD_DSPLIT_LEFT || SHIELD_DSPLIT_RIGHT
```

## boards/shields/dsplit/Kconfig.shield
```kconfig
config SHIELD_DSPLIT_LEFT
    def_bool $(shields_list_contains,dsplit_left)

config SHIELD_DSPLIT_RIGHT
    def_bool $(shields_list_contains,dsplit_right)
```
